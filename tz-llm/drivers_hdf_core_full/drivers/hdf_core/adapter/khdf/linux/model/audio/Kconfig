## tz-llm/drivers_hdf_core_full/drivers/hdf_core/adapter/khdf/linux/model/audio/Kconfig
```kconfig
config DRIVERS_HDF_AUDIO
    bool "Enable HDF Audio driver"
    default n
    depends on DRIVERS_HDF
    help
        Answer Y to choice HDF Audio driver.

config DRIVERS_HDF_AUDIO_HDMI
    bool "Enable HDF Audio HDMI driver"
    default n
    depends on DRIVERS_HDF_AUDIO
    help
        Answer Y to choice HDF Audio HDMI driver.

config DRIVERS_HDF_AUDIO_USB
    bool "Enable HDF Audio USB driver"
    default n
    depends on DRIVERS_HDF_AUDIO
    help
        Answer Y to choice HDF Audio USB driver.

config DRIVERS_HDF_AUDIO_HI3516CODEC
    bool "Enable HDF Audio Codec driver"
    default n
    depends on DRIVERS_HDF_AUDIO
    help
        Answer Y to choice HDF Audio Codec driver.

config DRIVERS_HDF_AUDIO_RK3568
    bool "Enable HDF Audio Codec driver"
    default n
    depends on DRIVERS_HDF_AUDIO
    help
        Answer Y to choice HDF Audio Codec driver.

config DRIVERS_HDF_AUDIO_RK3566
    bool "Enable HDF Audio Codec driver"
    default n
    depends on DRIVERS_HDF_AUDIO
    help
        Answer Y to choice HDF Audio Codec driver.

config DRIVERS_HDF_AUDIO_ANA_HEADSET
    bool "Audio Headset support"
    default n
    depends on DRIVERS_HDF_AUDIO_RK3568
    help
        Audio Headset support:
            support hook interrupt mode.
            support hook adc mode.

config DRIVERS_HDF_AUDIO_RK3588
    bool "Enable HDF Audio Codec driver"
    default n
    depends on DRIVERS_HDF_AUDIO
    help
        Answer Y to choice HDF Audio Codec driver For RK3588.

config DRIVERS_HDF_AUDIO_ANA_HEADSET_RK3566
    bool "Audio Headset support"
    default n
    depends on DRIVERS_HDF_AUDIO_RK3566
    help
        Audio Headset support:
            support hook interrupt mode.
            support hook adc mode.
	    
config DRIVERS_HDF_AUDIO_CAP_REPORT
    bool "Audio capture event report"
    default n
    depends on DRIVERS_HDF_AUDIO
    help
        Answer Y to choice capture event report.

config DRIVERS_HDF_AUDIO_TEST
    bool "Enable HDF Audio driver Test"
    default n
    depends on DRIVERS_HDF_AUDIO
    help
        Answer Y to choice HDF Audio driver Test.

config DRIVERS_HDF_AUDIO_A311D
    bool "Enable HDF Audio Codec driver"
    default n
    depends on DRIVERS_HDF_AUDIO
    help
        Answer Y to choice HDF Audio Codec driver.

config DRIVERS_HDF_AUDIO_IMX8MM
    bool "Enable HDF Audio Codec driver"
    default n
    depends on DRIVERS_HDF_AUDIO
    help
        Answer Y to choice HDF Audio Codec driver.

config DRM_DW_HDMI_I2S_AUDIO
    bool "Synopsys Designware I2S Audio interface"
    default n
    depends on DRIVERS_HDF_AUDIO
    help
        Support the I2S Audio interface which is part of the Synopsys
        Designware HDMI block.
```

## tz-llm/drivers_hdf_core_full/drivers/hdf_core/adapter/khdf/linux/model/network/wifi/Kconfig
```kconfig
config DRIVERS_HDF_WIFI
    bool "Enable HDF wifi"
    default n
    depends on DRIVERS_HDF_NETWORK
    select DRIVERS_HDF_WIFI_BUS
    help
      Answer Y to enable HDF wifi.

config DRIVERS_HI3881
    bool "Enable hi3881"
    default n
    depends on DRIVERS_HDF_WIFI
    help
      Answer Y to enable hi3881 wifi chip driver.

config DRIVERS_HDF_NETDEV_EXT
    bool "Get Linux net device from HDF"
    default n
    help
      Get Linux net device from HDF

config DRIVERS_RTL8723DU
    bool "Enable Realtek 8723D USB WiFi(rtl8723du)"
    default n
    depends on DRIVERS_HDF_WIFI
    select DRIVERS_HDF_WLAN_USB
    select DRIVERS_HDF_NETDEV_EXT
    help
      Answer Y to enable rtl8723du wifi chip driver.

config AP6XXX_WIFI6_HDF
    tristate "support ap6xxx wifi6(80211ax) HDF"
    depends on DRIVERS_HDF_WIFI
    select CFG80211
    select MAC80211
    select DRIVERS_HDF_NETDEV_EXT
    help
      This driver supports wifi6 for ap6xxx HDF chipset.
      This driver uses the kernel's wireless extensions subsystem.
      If you choose to build a module, it'll be called dhd. Say M if unsure.
      
config DRIVERS_AP6212
    bool "Enable ap6212"
    default n
    depends on DRIVERS_HDF_WIFI
    help
      Answer Y to enable ap6212 wifi chip driver.

config DRIVERS_AP6256
    bool "Enable ap6256"
    default n
    depends on DRIVERS_HDF_WIFI
    help
      Answer Y to enable ap62256 wifi chip driver.

config DRIVERS_HDF_IMX8MM_ETHERNET
    bool "Enable imx8mm ethernet"
    default n
    depends on DRIVERS_HDF_WIFI
    help
      Answer Y to enable imx8mm ethernet driver.
```

## tz-llm/drivers_hdf_core_full/drivers/hdf_core/adapter/khdf/linux/model/network/wifi/bus/Kconfig
```kconfig
# Copyright (c) 2022 Huawei Device Co., Ltd.
#
# This software is licensed under the terms of the GNU General Public
# License version 2, as published by the Free Software Foundation, and
# may be copied, distributed, and modified under those terms.
#
# This program is distributed in the hope that it will be useful,
# but WITHOUT ANY WARRANTY; without even the implied warranty of
# MERCHANTABILITY or FITNESS FOR A PARTICULAR PURPOSE. See the
# GNU General Public License for more details.

config DRIVERS_HDF_WIFI_BUS
    bool "Enable HDF WiFi Bus Host driver"
    default n
    help
      Answer Y to enable HDF WiFi Bus Host driver.

if DRIVERS_HDF_WIFI_BUS
choice
  prompt "Select wlan sdio or usb source"
  default DRIVERS_HDF_WLAN_SDIO

  config DRIVERS_HDF_WLAN_SDIO
    bool "Enable HDF wlan sdio bus"
    default n
    depends on DRIVERS_HDF_PLATFORM_SDIO
    help
      Answer Y to support HDF wlan sdio bus.

  config DRIVERS_HDF_WLAN_USB
    bool "Enable HDF Wlan usb bus"
    default n
    depends on DRIVERS_HDF_USB_PNP_NOTIFY
    help
      Answer Y to support HDF wlan usb bus.
endchoice
endif
```

## tz-llm/drivers_hdf_core_full/drivers/hdf_core/adapter/khdf/linux/platform/Kconfig
```kconfig
config DRIVERS_HDF_PLATFORM
    bool "Enable HDF platform driver"
        default n
    depends on DRIVERS_HDF
        help
      Answer Y to enable HDF platform driver.

config DRIVERS_HDF_PLATFORM_MIPI_DSI
    bool "Enable HDF platform mipi dsi driver"
    default n
    depends on DRIVERS_HDF_PLATFORM
    help
      Answer Y to enable HDF platform mipi dsi driver.

config DRIVERS_HDF_PLATFORM_MIPI_CSI
    bool "Enable HDF platform mipi csi driver"
    default n
    depends on DRIVERS_HDF_PLATFORM
    help
      Answer Y to enable HDF platform mipi csi driver.

config DRIVERS_HDF_PLATFORM_GPIO
    bool "Enable HDF platform gpio driver"
    default n
    depends on DRIVERS_HDF_PLATFORM
    help
      Answer Y to enable HDF platform gpio driver.

config DRIVERS_HDF_PLATFORM_I2C
    bool "Enable HDF platform i2c driver"
    default n
    depends on DRIVERS_HDF_PLATFORM
    help
      Answer Y to enable HDF platform i2c driver.

config USER_I2C_SUPPORT
    bool "Enable HDF platform i2c user interface"
    default y
    depends on DRIVERS_HDF_PLATFORM
    help
      Answer N to disable HDF platform i2c user interface.

config DRIVERS_HDF_PLATFORM_WATCHDOG
    bool "Enable HDF platform watchdog driver"
    default n
    depends on DRIVERS_HDF_PLATFORM
    help
      Answer Y to enable HDF platform watchdog driver.

config DRIVERS_HDF_PLATFORM_PWM
    bool "Enable HDF platform pwm driver"
    depends on DRIVERS_HDF_PLATFORM
    help
      Answer Y to enable HDF platform pwm driver.

config DRIVERS_HDF_PLATFORM_UART
    bool "Enable HDF platform uart driver"
    depends on DRIVERS_HDF_PLATFORM
    help
      Answer Y to enable HDF platform uart driver.

config DRIVERS_HDF_PLATFORM_SDIO
    bool "Enable HDF platform sdio driver"
    default n
    depends on DRIVERS_HDF_PLATFORM && DRIVERS_HDF_PLATFORM_MMC
    help
      Answer Y to enable HDF platform sdio driver.

config DRIVERS_HDF_PLATFORM_EMMC
    bool "Enable HDF platform emmc driver"
    default n
    depends on DRIVERS_HDF_PLATFORM
    help
      Answer Y to enable HDF platform emmc driver.

config DRIVERS_HDF_PLATFORM_MMC
    bool "Enable HDF platform mmc driver"
    default n
    depends on DRIVERS_HDF_PLATFORM
    help
      Answer Y to enable HDF platform mmc driver.

config DRIVERS_HDF_PLATFORM_SPI
    bool "Enable HDF platform spi driver"
    default n
    depends on DRIVERS_HDF_PLATFORM
    help
      Answer Y to enable HDF platform spi driver.

config DRIVERS_HDF_PLATFORM_RTC
    bool "Enable HDF platform rtc driver"
    default n
    depends on DRIVERS_HDF_PLATFORM
    help
      Answer Y to enable HDF platform rtc driver.

config PWM_HI35XX
    bool "hi35xx pwm driver"
    depends on PWM
    help
      Answer Y to enable hi35xx pwm driver

config DRIVERS_HDF_PLATFORM_REGULATOR
    bool "Enable HDF platform regulator driver"
    default n
    depends on DRIVERS_HDF_PLATFORM
    help
      Answer Y to enable HDF platform regulator driver.

config DRIVERS_HDF_PLATFORM_ADC
    bool "Enable HDF platform adc driver"
    default n
    depends on DRIVERS_HDF_PLATFORM
    help
      Answer Y to enable HDF platform adc driver.

config DRIVERS_HDF_PLATFORM_CLOCK
    bool "Enable HDF platform clock driver"
    default n
    depends on DRIVERS_HDF_PLATFORM
    help
      Answer Y to enable HDF platform clock driver.

config DRIVERS_HDF_PLATFORM_TRACE
    bool "Enable HDF platform trace driver"
    default n
    depends on DRIVERS_HDF_PLATFORM
    help
      Answer Y to enable HDF platform trace driver.

config DRIVERS_HDF_PLATFORM_DUMPER
    bool "Enable HDF platform dumper driver"
    default n
    depends on DRIVERS_HDF_PLATFORM
    help
      Answer Y to enable HDF platform dumper driver.

config DRIVERS_HDF_PLATFORM_DUMPER_WRITE
    bool "Enable HDF platform dumper write file"
    default n
    depends on DRIVERS_HDF_PLATFORM_DUMPER
    help
      Answer Y to enable HDF platform dumper  write file.

config DRIVERS_HDF_PLATFORM_DUMPER_PRINT
    bool "Enable HDF platform dumper printf"
    default n
    depends on DRIVERS_HDF_PLATFORM_DUMPER
    help
      Answer Y to enable HDF platform dumper printf.

config IMX8MM_EMMC
    bool "Enable HDF imx8mm emmc driver"
    default n
    depends on DRIVERS_HDF
    help
      Answer Y to enable HDF imx8mm emmc driver.

config IMX8MM_SDIO
    bool "Enable HDF imx8mm sdio driver"
    default n
    depends on DRIVERS_HDF
    help
      Answer Y to enable HDF imx8mm sdio driver.

config DRIVERS_HDF_PLATFORM_IMX8MM_MIPI_DSI
    bool "Enable HDF platform imx8mm mipi_dsi driver"
    default n
    depends on DRIVERS_HDF_PLATFORM
    help
      Answer Y to enable HDF platform imx8mm mipi_dsi driver.
```

## tz-llm/drivers_hdf_core_full/drivers/hdf_core/adapter/khdf/liteos/model/network/wifi/bus/Kconfig
```kconfig
# Copyright (c) 2022-2023 Huawei Device Co., Ltd. All rights reserved.
#
# Redistribution and use in source and binary forms, with or without modification,
# are permitted provided that the following conditions are met:
#
# 1. Redistributions of source code must retain the above copyright notice, this list of
#    conditions and the following disclaimer.
#
# 2. Redistributions in binary form must reproduce the above copyright notice, this list
#    of conditions and the following disclaimer in the documentation and/or other materials
#    provided with the distribution.
#
# 3. Neither the name of the copyright holder nor the names of its contributors may be used
#    to endorse or promote products derived from this software without specific prior written
#    permission.
#
# THIS SOFTWARE IS PROVIDED BY THE COPYRIGHT HOLDERS AND CONTRIBUTORS
# "AS IS" AND ANY EXPRESS OR IMPLIED WARRANTIES, INCLUDING, BUT NOT LIMITED TO,
# THE IMPLIED WARRANTIES OF MERCHANTABILITY AND FITNESS FOR A PARTICULAR
# PURPOSE ARE DISCLAIMED. IN NO EVENT SHALL THE COPYRIGHT HOLDER OR
# CONTRIBUTORS BE LIABLE FOR ANY DIRECT, INDIRECT, INCIDENTAL, SPECIAL,
# EXEMPLARY, OR CONSEQUENTIAL DAMAGES (INCLUDING, BUT NOT LIMITED TO,
# PROCUREMENT OF SUBSTITUTE GOODS OR SERVICES; LOSS OF USE, DATA, OR PROFITS;
# OR BUSINESS INTERRUPTION) HOWEVER CAUSED AND ON ANY THEORY OF LIABILITY,
# WHETHER IN CONTRACT, STRICT LIABILITY, OR TORT (INCLUDING NEGLIGENCE OR
# OTHERWISE) ARISING IN ANY WAY OUT OF THE USE OF THIS SOFTWARE, EVEN IF
# ADVISED OF THE POSSIBILITY OF SUCH DAMAGE.

config DRIVERS_HDF_WIFI_BUS
    bool "Enable HDF WiFi Bus Host driver"
    default n
    help
      Answer Y to enable HDF WiFi Bus Host driver.

if DRIVERS_HDF_WIFI_BUS
choice
  prompt "Select wlan sdio, usb or pcie source"
  default DRIVERS_HDF_WLAN_SDIO

  config DRIVERS_HDF_WLAN_SDIO
    bool "Enable HDF WLAN Sdio Host driver"
    default n
    depends on DRIVERS_HDF_PLATFORM_SDIO
    help
      Answer Y to enable HDF WLAN Sdio Host driver.

  config DRIVERS_HDF_WLAN_USB
    bool "Enable HDF WLAN Usb Host driver"
    default n
    depends on DRIVERS_HDF_USB_PNP_NOTIFY
    help
      Answer Y to enable HDF WLAN Usb Host driver.

  config DRIVERS_HDF_WLAN_PCIE
    bool "Enable HDF WLAN Pcie Host driver"
    default n
    depends on DRIVERS_HDF_PLATFORM_PCIE
    help
      Answer Y to enable HDF WLAN Pcie Host driver.
endchoice
endif
```
